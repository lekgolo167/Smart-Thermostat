#include "Weather.hpp"
#include "parson.h"


static const uint8_t icon_clear_day[288]{
	0x00, 0x00, 0x00, 0x00, 0x00, 0x00,
	0x00, 0x00, 0x00, 0x00, 0x00, 0x00,
	0x00, 0x00, 0x00, 0x00, 0x00, 0x00,
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	0x00, 0x00, 0x00, 0x00, 0x00, 0x00};

static const uint8_t icon_clear_night[288]{
	0x00, 0x00, 0x00, 0x00, 0x00, 0x00,
	0x00, 0x00, 0x00, 0x00, 0x00, 0x00,
	0x00, 0x00, 0x00, 0x00, 0x00, 0x00,
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	0x00, 0x00, 0x00, 0x00, 0x00, 0x00};

static const uint8_t icon_cloudy[288]{
	0x00, 0x00, 0x00, 0x00, 0x00, 0x00,
	0x00, 0x00, 0x00, 0x00, 0x00, 0x00,
	0x00, 0x00, 0x00, 0x00, 0x00, 0x00,
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	0x00, 0x00, 0x00, 0x00, 0x00, 0x00};

static const uint8_t icon_fog[288]{
	0x00, 0x00, 0x00, 0x00, 0x00, 0x00,
	0x00, 0x00, 0x00, 0x00, 0x00, 0x00,
	0x00, 0x00, 0x00, 0x00, 0x00, 0x00,
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	0x00, 0x00, 0x00, 0x00, 0x00, 0x00};

static const uint8_t icon_partly_cloudy_day[288]{
	0x00, 0x00, 0x00, 0x00, 0x00, 0x00,
	0x00, 0x00, 0x00, 0x00, 0x00, 0x00,
	0x00, 0x00, 0x00, 0x00, 0x00, 0x00,
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	0x00, 0x00, 0x00, 0x00, 0x00, 0x00};

static const uint8_t icon_partly_cloudy_night[288]{
	0x00, 0x00, 0x00, 0x00, 0x00, 0x00,
	0x00, 0x00, 0x00, 0x00, 0x00, 0x00,
	0x00, 0x00, 0x00, 0x00, 0x00, 0x00,
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	0x00, 0x00, 0x00, 0x00, 0x00, 0x00};

static const uint8_t icon_partly_cloudy_rain[288]{
	0x00, 0x00, 0x00, 0x00, 0x00, 0x00,
	0x00, 0x00, 0x00, 0x00, 0x00, 0x00,
	0x00, 0x01, 0x80, 0x00, 0x00, 0x00,
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	0x00, 0x00, 0x00, 0x00, 0x00, 0x00};

static const uint8_t icon_rain[288]{
	0x00, 0x00, 0x00, 0x00, 0x00, 0x00,
	0x00, 0x00, 0x00, 0x00, 0x00, 0x00,
	0x00, 0x00, 0x00, 0x00, 0x00, 0x00,
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	0x00, 0x00, 0x00, 0x00, 0x00, 0x00};

static const uint8_t icon_sleet[288]{
	0x00, 0x00, 0x00, 0x00, 0x00, 0x00,
	0x00, 0x00, 0x00, 0x00, 0x00, 0x00,
	0x00, 0x00, 0x00, 0x00, 0x00, 0x00,
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	0x00, 0x00, 0x00, 0x00, 0x00, 0x00};

static const uint8_t icon_snow[288]{
	0x00, 0x00, 0x00, 0x00, 0x00, 0x00,
	0x00, 0x00, 0x00, 0x00, 0x00, 0x00,
	0x00, 0x00, 0x00, 0x00, 0x00, 0x00,
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	0x00, 0x00, 0x00, 0x00, 0x00, 0x00};

static const uint8_t icon_thunderstorm[288]{
	0x00, 0x00, 0x00, 0x00, 0x00, 0x00,
	0x00, 0x00, 0x00, 0x00, 0x00, 0x00,
	0x00, 0x00, 0x00, 0x00, 0x00, 0x00,
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	0x00, 0x00, 0x00, 0x00, 0x00, 0x00};

static const uint8_t icon_wind[288]{
	0x00, 0x00, 0x00, 0x00, 0x00, 0x00,
	0x00, 0x00, 0x00, 0x00, 0x00, 0x00,
	0x00, 0x00, 0x00, 0x00, 0x00, 0x00,
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	0x00, 0x00, 0x00, 0x00, 0x00, 0x00};

enum weather_icons
{
	CLEAR_DAY,
	CLEAR_NIGHT,
	RAIN,
	SNOW,
	SLEET,
	WIND,
	FOG,
	CLOUDY,
	PARTLY_CLOUDY_DAY,
	PARTLY_CLOUDY_NIGHT,
	THUNDERSTORM,
	HAIL
};

Weather::Weather()
{
	for (int hr = 0; hr < FORECAST_HOURS; hr++)
	{
		weather_data_t *wd = new weather_data_t{
			this->get_icon(hr % 12),
			int8_t(50 + hr),
			int8_t(45 + 0.2 * hr),
			0};

		hourly_data[hr] = wd;
	}

	for (int day = 0; day < FORECAST_DAYS; day++)
	{
		forecast_data[day] = new weather_data_t{
			hourly_data[day]->icon,
			hourly_data[day]->high,
			hourly_data[day]->low,
			};
		forecast_data[day]->day = day;
	}

	current_weather = hourly_data[0];
	current_day = -1;
}

Weather::~Weather()
{

}

bool Weather::is_new_day(int day)
{
	return current_day != day;
}

const uint8_t* Weather::get_icon(int icon)
{
	switch (icon)
	{
	case CLEAR_DAY:
		return icon_clear_day;
		break;
	case CLEAR_NIGHT:
		return icon_clear_night;
		break;
	case RAIN:
		return icon_rain;
		break;
	case SNOW:
		return icon_snow;
		break;
	case SLEET:
		return icon_sleet;
		break;
	case WIND:
		return icon_wind;
		break;
	case FOG:
		return icon_fog;
		break;
	case CLOUDY:
		return icon_cloudy;
		break;
	case PARTLY_CLOUDY_DAY:
		return icon_partly_cloudy_day;
		break;
	case PARTLY_CLOUDY_NIGHT:
		return icon_partly_cloudy_night;
		break;
	case THUNDERSTORM:
		return icon_thunderstorm;
		break;
	case HAIL:
		return icon_partly_cloudy_rain;
		break;
	default:
		return icon_clear_day;
		break;
	}
}

void Weather::get_weather(Messenger& messenger, int today)
{
	char buffer[1024];

	int result = messenger.get_request(URL_GET_FORECAST, buffer, 1024);
	if (result < 1) {
		// request failed
		return;
	}
	current_day = today;
	
	JSON_Value* raw = json_parse_string(buffer);
	JSON_Object* obj = json_value_get_object(raw);
	JSON_Array* hourly_array = json_object_get_array(obj, "hourly");
	int hours = min(json_array_get_count(hourly_array), FORECAST_HOURS);

	for (int i=0; i < hours; i++) {
		JSON_Object* hour_obj = json_array_get_object(hourly_array, i);
		int icon = (int)json_object_get_number(hour_obj, "i");
		int temp = (int)json_object_get_number(hour_obj, "t");
		hourly_data[i]->icon = get_icon(icon);
		hourly_data[i]->high = temp;
	}

	JSON_Array* daily_array = json_object_get_array(obj, "daily");
	int days = min(json_array_get_count(daily_array), FORECAST_DAYS);
	for (int i=0; i < days; i++) {
		JSON_Object* daily_obj = json_array_get_object(daily_array, i);
		int day = (int)json_object_get_number(daily_obj, "d");
		int icon = (int)json_object_get_number(daily_obj, "i");
		int tH = (int)json_object_get_number(daily_obj, "H");
		int tL = (int)json_object_get_number(daily_obj, "L");
		forecast_data[i]->day = day;
		forecast_data[i]->icon = get_icon(icon);
		forecast_data[i]->high = tH;
		forecast_data[i]->low = tL;
	}
	json_value_free(raw);
}

void Weather::set_current_weather(int hr)
{
	if (hr >= 0 && hr <= 24)
	{
		current_weather = hourly_data[hr];
	}
}

weather_data_t* Weather::get_current_weather()
{
			Serial.print("Getting weather: ");

		Serial.print(" T: ");
		Serial.println(current_weather->high);
	return current_weather;
}

weather_data_t* Weather::get_forecast(int day)
{
	day--;
	if (day >= 0 && day <= 2)
	{
		return forecast_data[day];
	}
	else
	{
		return forecast_data[0];
	}
}
